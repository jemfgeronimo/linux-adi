## Documentation/devicetree/bindings/iio/adc/adi,ad5940.yaml
```yaml
# SPDX-License-Identifier: (GPL-2.0-only OR BSD-2-Clause)
# Copyright 2019 Analog Devices Inc.
%YAML 1.2
---
$id: http://devicetree.org/schemas/iio/adc/adi,ad5940.yaml#
$schema: http://devicetree.org/meta-schemas/core.yaml#

title: Analog Devices AD5940 High Precision, Impedance and Electrochemical Front End

maintainers:
  - Song Qiang <songqiang1304521@gmail.com>

description: |
  Analog Devices AD5940 high precision, impedance and electrochemical analog
  front end with an SPI interface.

  Datasheet:
    https://www.analog.com/media/en/technical-documentation/data-sheets/ad5940.pdf

allOf:
  - $ref: /schemas/spi/spi-peripheral-props.yaml#

properties:
  compatible:
    const: adi,ad5940

  reg:
    maxItems: 1

  spi-max-frequency:
    maximum: 16000000

  vref-supply:
    description:
      The regulator used to supply the reference voltage. If not provided, the
      nominal 1.82 V internal reference is assumed.

  interrupts:
    maxItems: 1

  adi,interrupt-io:
    $ref: /schemas/types.yaml#/definitions/uint32
    description:
      Index of the AFE GPIO that outputs the interrupt controller signal.
    enum: [0, 3, 6]

  '#address-cells':
    const: 1

  '#size-cells':
    const: 0

patternProperties:
  "^channel@[0-9a-f]+$":
    type: object
    $ref: adc.yaml
    unevaluatedProperties: false

    properties:
      reg:
        description: Index of this channel, starting from 0.
        maxItems: 1

      diff-channels:
        description: |
          Positive and negative input of the ADC mux for this channel. The
          allowed values are defined in
          include/dt-bindings/iio/adc/adi,ad5940.h, with AD5940_ADC_INPUTP_*
          for the positive input and AD5940_ADC_INPUTN_* for the negative one.

      label:
        description: Name assigned to this channel.

    required:
      - reg
      - diff-channels

required:
  - compatible
  - reg
  - interrupts
  - adi,interrupt-io
  - '#address-cells'
  - '#size-cells'

unevaluatedProperties: false

examples:
  - |
    #include <dt-bindings/iio/adc/adi,ad5940.h>
    #include <dt-bindings/interrupt-controller/irq.h>

    spi {
        #address-cells = <1>;
        #size-cells = <0>;

        adc@0 {
            compatible = "adi,ad5940";
            reg = <0>;
            spi-max-frequency = <16000000>;
            vref-supply = <&adc_vref>;
            interrupt-parent = <&gpio>;
            interrupts = <24 IRQ_TYPE_EDGE_FALLING>;
            adi,interrupt-io = <0>;
            #address-cells = <1>;
            #size-cells = <0>;

            channel@0 {
                reg = <0>;
                diff-channels = <AD5940_ADC_INPUTP_VCE0
                                 AD5940_ADC_INPUTN_VBIAS0>;
                label = "Vce-Vbias";
            };

            channel@1 {
                reg = <1>;
                diff-channels = <AD5940_ADC_INPUTP_AIN0
                                 AD5940_ADC_INPUTN_VBIAS0>;
                label = "ain0-Vbias";
            };
        };
    };
...
```
